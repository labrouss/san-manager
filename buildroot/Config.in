## buildroot/configs/san_platform_defconfig
```kconfig
# =============================================================================
# buildroot/configs/san_platform_defconfig
#
# Buildroot 2024.02.x — SAN Management Platform OVA
#
# All symbols validated against Buildroot 2024.02.9 Config.in trees.
# Moving-target symbols (LATEST_VERSION, LATEST_LTS_*) are avoided entirely
# — an explicit kernel version is pinned instead for build reproducibility.
#
# Symbols that require dependency ordering (systemd, wchar, TLS, libcurl)
# are injected by scripts/patch-buildroot-config.py after defconfig load.
# =============================================================================

# ── Architecture ──────────────────────────────────────────────────────────────
BR2_x86_64=y
BR2_TARGET_OPTIMIZATION="-O2 -pipe -march=x86-64-v2"

# ── Toolchain (base — wchar+TLS injected by patch script) ─────────────────────
BR2_TOOLCHAIN_BUILDROOT_MUSL=y
BR2_TOOLCHAIN_BUILDROOT_CXX=y
BR2_GCC_VERSION_13_X=y
BR2_BINUTILS_VERSION_2_41_X=y

# ── System ────────────────────────────────────────────────────────────────────
BR2_SYSTEM_DHCP="eth0"
BR2_TARGET_GENERIC_HOSTNAME="san-platform"
BR2_TARGET_GENERIC_ISSUE="SAN Management Platform"
BR2_TARGET_TZ_INFO=y
BR2_TARGET_LOCALTIME="UTC"

# ── Init: systemd injected by patch script after defconfig load ───────────────

# ── Kernel — explicit version (no moving-target LATEST_* symbols) ─────────────
# 6.6.63 is the version Buildroot 2024.02.9 pins as its LTS kernel.
BR2_LINUX_KERNEL=y
BR2_LINUX_KERNEL_CUSTOM_VERSION=y
BR2_LINUX_KERNEL_CUSTOM_VERSION_VALUE="6.6.63"
BR2_LINUX_KERNEL_USE_DEFCONFIG=y
BR2_LINUX_KERNEL_DEFCONFIG="x86_64"
BR2_LINUX_KERNEL_CONFIG_FRAGMENT_FILES="$(BR2_EXTERNAL_SAN_PLATFORM_PATH)/board/san-platform/linux-docker.fragment"
BR2_LINUX_KERNEL_NEEDS_HOST_OPENSSL=y

# ── Bootloader — UEFI only (EFI x86-64) ──────────────────────────────────────
# BR2_TARGET_GRUB2_I386_PC is intentionally omitted: it selects
# BR2_TARGET_GRUB2_HAS_LEGACY_BOOT which is a legacy symbol in 2024.02
# and triggers the fatal BR2_LEGACY=y check. All modern hypervisors
# (VMware ESXi, Workstation, Fusion, VirtualBox) support EFI boot.
BR2_TARGET_GRUB2=y
BR2_TARGET_GRUB2_X86_64_EFI=y

# ── Root filesystem ───────────────────────────────────────────────────────────
BR2_TARGET_ROOTFS_EXT2=y
BR2_TARGET_ROOTFS_EXT2_4=y
BR2_TARGET_ROOTFS_EXT2_SIZE="3072M"
BR2_ROOTFS_OVERLAY="$(BR2_EXTERNAL_SAN_PLATFORM_PATH)/board/san-platform/rootfs-overlay"
BR2_ROOTFS_POST_BUILD_SCRIPT="$(BR2_EXTERNAL_SAN_PLATFORM_PATH)/board/san-platform/post-build.sh"
BR2_ROOTFS_POST_IMAGE_SCRIPT="$(BR2_EXTERNAL_SAN_PLATFORM_PATH)/board/san-platform/post-image.sh"

# ── Host tools ────────────────────────────────────────────────────────────────
BR2_PACKAGE_HOST_GENIMAGE=y
BR2_PACKAGE_HOST_DOSFSTOOLS=y
BR2_PACKAGE_HOST_MTOOLS=y
BR2_PACKAGE_HOST_PARTED=y

# ── Core utilities ────────────────────────────────────────────────────────────
BR2_PACKAGE_BUSYBOX=y
BR2_PACKAGE_BASH=y
BR2_PACKAGE_CA_CERTIFICATES=y
BR2_PACKAGE_OPENSSL=y
BR2_PACKAGE_OPENSSH=y
BR2_PACKAGE_LIBCURL=y
BR2_PACKAGE_LIBCURL_CURL=y

# ── Filesystem & disk tools ───────────────────────────────────────────────────
BR2_PACKAGE_E2FSPROGS=y
BR2_PACKAGE_E2FSPROGS_RESIZE2FS=y
BR2_PACKAGE_PARTED=y
BR2_PACKAGE_UTIL_LINUX=y
BR2_PACKAGE_UTIL_LINUX_MOUNT=y

# ── Networking ────────────────────────────────────────────────────────────────
BR2_PACKAGE_IPTABLES=y
BR2_PACKAGE_IPROUTE2=y
BR2_PACKAGE_NFTABLES=y
BR2_PACKAGE_BRIDGE_UTILS=y

# ── Container runtime ─────────────────────────────────────────────────────────
BR2_PACKAGE_DOCKER_ENGINE=y
BR2_PACKAGE_DOCKER_CLI=y
BR2_PACKAGE_DOCKER_COMPOSE=y

# ── Time sync ─────────────────────────────────────────────────────────────────
BR2_PACKAGE_CHRONY=y

# ── Ops tooling ───────────────────────────────────────────────────────────────
BR2_PACKAGE_HTOP=y
BR2_PACKAGE_LESS=y
BR2_PACKAGE_VIM_TINY=y
BR2_PACKAGE_JQ=y

# ── Build cache ───────────────────────────────────────────────────────────────
BR2_CCACHE=y
```
